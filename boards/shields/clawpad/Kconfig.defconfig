## boards/shields/clawpad/Kconfig.defconfig
```kconfig
# Copyright (c) 2024 The ZMK Contributors
# SPDX-License-Identifier: MIT

if SHIELD_CLAWPAD

config ZMK_KEYBOARD_NAME
    default "CLAWPAD"

endif
```
